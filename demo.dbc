VERSION ""

NS_ :

BS_:
BU_:
BO_ 1 demo2: 8 Vector__XXX
   SG_ demoSig278 : 0|16@1- (0.01,52) [0|1] "testunits" Vector__XXX
   SG_ demoSig27870 : 16|16@1- (10,-423) [0|1] "testunits10" Vector__XXX

BA_DEF_ BO_ "GenMsgBackgroundColor" STRING ;
BA_DEF_ BO_ "GenMsgForegroundColor" STRING ;
BA_DEF_ BO_ "filterlabeling" INT 0 0;
BA_DEF_DEF_ "GenMsgBackgroundColor" "#ffffff";
BA_DEF_DEF_ "GenMsgForegroundColor" "#000000";
BA_DEF_DEF_ "filterlabeling" 1;
CM_ SG_ 1 demoSig278 "mycomment";
CM_ SG_ 1 demoSig27870 "mycomment";
